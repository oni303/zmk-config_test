#define COMBO_TERM_FAST 35
#define COMBO_TERM_SLOW 40
#define COMBO_PRIOR_IDLE 100

/ {
      combos {
        compatible = "zmk,combos";

        layer3 {
            bindings = <&mo 0>;
            key-positions = <37 40>;
        };
    };
};
